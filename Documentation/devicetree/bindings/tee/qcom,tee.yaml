## Documentation/devicetree/bindings/tee/qcom,tee.yaml
```yaml
# SPDX-License-Identifier: (GPL-2.0 OR BSD-2-Clause)
%YAML 1.2
---
$id: "http://devicetree.org/schemas/soc/qcom/qcom,tee.yaml#"
$schema: "http://devicetree.org/meta-schemas/core.yaml#"

title: Qualcomm Trusted Execution Environment (TEE) binding

maintainers:
  - Srinivas Kandagatla <srinivas.kandagatla@linaro.org>

description:
  This binding describes the Qualcomm Trusted Execution Environment(QTEE),
  that is used for communication between REE (Rich Operating System
  Execution Environment) and QTEE applications in Trust Zone.

properties:
  compatible:
    const: qcom,tee

required:
  - compatible

additionalProperties: false

examples:
  - |

    tee {
        compatible = "qcom,tee";
    };

...
```

## drivers/bus/mhi/ep/Kconfig
```kconfig
config MHI_BUS_EP
	tristate "Modem Host Interface (MHI) bus Endpoint implementation"
	help
	  Bus driver for MHI protocol. Modem Host Interface (MHI) is a
	  communication protocol used by a host processor to control
	  and communicate a modem device over a high speed peripheral
	  bus or shared memory.

	  MHI_BUS_EP implements the MHI protocol for the endpoint devices,
	  such as SDX55 modem connected to the host machine over PCIe.

config MHI_EP_USE_DMA
	bool "Use DMA for buffer transfers"
	depends on MHI_BUS_EP
	default n
	help
	  Use DMA channels to transfer data between RC and EP sides. By default
	  the driver uses PCIe mapping and memcpy_fromio/memcpy_toio instead.
```

## drivers/dma/dw-edma/Kconfig
```kconfig
# SPDX-License-Identifier: GPL-2.0

config DW_EDMA
	tristate "Synopsys DesignWare eDMA controller driver"
	depends on PCI && PCI_MSI
	select DMA_ENGINE
	select DMA_VIRTUAL_CHANNELS
	help
	  Support the Synopsys DesignWare eDMA controller, normally
	  implemented on endpoints SoCs.

config DW_EDMA_PCIE
	tristate "Synopsys DesignWare eDMA PCIe driver"
	depends on PCI && PCI_MSI
	select DW_EDMA
	help
	  Provides a glue-logic between the Synopsys DesignWare
	  eDMA controller and an endpoint PCIe device. This also serves
	  as a reference design to whom desires to use this IP.

config DW_EDMA_QCOM
	tristate "Synopsys DesignWare eDMA on Qualcomm platforms"
	depends on ARCH_QCOM || COMPILE_TEST
	select DW_EDMA
	help
	  Provides support for the eDMA blocks found on some of Qualcomm
	  Snapdragon SoC families.
```

## drivers/tee/qcomtee/Kconfig
```kconfig
# SPDX-License-Identifier: MIT
# Qualcomm Trusted Execution Environment Configuration
config QCOMTEE
	tristate "Qualcomm TEE"
	default m
	help
	  This implements Qualcomm's Trusted Execution Environment (TEE) driver.
```
